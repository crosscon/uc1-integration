## west.yml
```yaml
manifest:
  self:
    path: crosscon-uc1-1

  defaults:
    remote: upstream

  remotes:
    - name: upstream
      url-base: https://github.com/zephyrproject-rtos
    - name: 3mdeb
      url-base: https://github.com/3mdeb
    - name: wolfssl
      url-base: https://github.com/wolfssl

  projects:
    - name: zephyr
      remote: 3mdeb
      revision: 271047d959e957467be4093509d7bea2a85fab36
      path: zephyr
      west-commands: scripts/west-commands.yml

    - name: hal_nxp
      revision: 3c64cd63125c86870802a561ce79dc33697b005c
      path: modules/hal/nxp
      groups:
        - hal

    - name: cmsis
      revision: 4b96cbb174678dcd3ca86e11e1f24bc5f8726da0
      path: modules/hal/cmsis
      groups:
        - hal

    - name: trusted-firmware-m
      remote: 3mdeb
      revision: ec9a0cce8db3594a7bdb59803de263cc8d1f052c
      path: modules/tee/tf-m/trusted-firmware-m
      groups:
        - tee

    - name: mbedtls
      revision: a78176c6ff0733ba08018cba4447bd3f20de7978
      path: modules/crypto/mbedtls
      groups:
        - crypto

    - name: mcuboot
      revision: f74b77cf7808919837c0ed14c2ead3918c546349
      path: bootloader/mcuboot
      groups:
        - bootloader

    - name: wolfssl
      path: modules/crypto/wolfssl
      revision: a1b644202ccb4a577b38bf4e05731ecd7e7651b9
      remote: wolfssl
```
